/dts-v1/; /plugin/;
/ {
	fragment@0 {
		target-path = "/fpga-top-region";
		__overlay__ {
			firmware-name = "examlpe1.bin";
			fpga-clk0 {
				region-rate     = <250000000>;
				region-enable   = <1>;
				region-resource = <0>;
			};
		};
        };
};
